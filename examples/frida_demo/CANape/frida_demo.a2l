/* Created by xcp_client with ELF/DWARF information only, offline mode - 2026-09-19 11:56:28 */ ASAP2_VERSION 1 71
/begin PROJECT project_name ""
/begin HEADER "" VERSION "1.0" PROJECT_NO XCPLITE__ACSDD /end HEADER
/begin MODULE project_name ""
/include "XCP_104.aml"
/begin MOD_COMMON "" BYTE_ORDER MSB_LAST ALIGNMENT_BYTE 1 ALIGNMENT_WORD 1 ALIGNMENT_LONG 1 ALIGNMENT_FLOAT16_IEEE 1 ALIGNMENT_FLOAT32_IEEE 1 ALIGNMENT_FLOAT64_IEEE 1 ALIGNMENT_INT64 1 /end MOD_COMMON
/* Predefined conversion rule for bool */
/begin COMPU_METHOD BOOL "" TAB_VERB "%.0" "" COMPU_TAB_REF BOOL.table /end COMPU_METHOD
/begin COMPU_VTAB BOOL.table "" TAB_VERB 2 0 "false" 1 "true" /end COMPU_VTAB
/* Predefined conversion rule identity with no phys unit and zero decimal places */
/begin COMPU_METHOD IDENTITY "" IDENTICAL "%.0" "" /end COMPU_METHOD
/* Predefined characteristic record layouts for standard types */
/begin RECORD_LAYOUT BOOL FNC_VALUES 1 UBYTE ROW_DIR DIRECT /end RECORD_LAYOUT
/begin RECORD_LAYOUT U8 FNC_VALUES 1 UBYTE ROW_DIR DIRECT /end RECORD_LAYOUT
/begin RECORD_LAYOUT U16 FNC_VALUES 1 UWORD ROW_DIR DIRECT /end RECORD_LAYOUT
/begin RECORD_LAYOUT U32 FNC_VALUES 1 ULONG ROW_DIR DIRECT /end RECORD_LAYOUT
/begin RECORD_LAYOUT U64 FNC_VALUES 1 A_UINT64 ROW_DIR DIRECT /end RECORD_LAYOUT
/begin RECORD_LAYOUT I8 FNC_VALUES 1 SBYTE ROW_DIR DIRECT /end RECORD_LAYOUT
/begin RECORD_LAYOUT I16 FNC_VALUES 1 SWORD ROW_DIR DIRECT /end RECORD_LAYOUT
/begin RECORD_LAYOUT I32 FNC_VALUES 1 SLONG ROW_DIR DIRECT /end RECORD_LAYOUT
/begin RECORD_LAYOUT I64 FNC_VALUES 1 A_INT64 ROW_DIR DIRECT /end RECORD_LAYOUT
/begin RECORD_LAYOUT F32 FNC_VALUES 1 FLOAT32_IEEE ROW_DIR DIRECT /end RECORD_LAYOUT
/begin RECORD_LAYOUT F64 FNC_VALUES 1 FLOAT64_IEEE ROW_DIR DIRECT /end RECORD_LAYOUT
/* Predefined axis record layouts for standard types */
/begin RECORD_LAYOUT A_U8 AXIS_PTS_X 1 UBYTE INDEX_INCR DIRECT /end RECORD_LAYOUT
/begin RECORD_LAYOUT A_U16 AXIS_PTS_X 1 UWORD INDEX_INCR DIRECT /end RECORD_LAYOUT
/begin RECORD_LAYOUT A_U32 AXIS_PTS_X 1 ULONG INDEX_INCR DIRECT /end RECORD_LAYOUT
/begin RECORD_LAYOUT A_U64 AXIS_PTS_X 1 A_UINT64 INDEX_INCR DIRECT /end RECORD_LAYOUT
/begin RECORD_LAYOUT A_I8 AXIS_PTS_X 1 SBYTE INDEX_INCR DIRECT /end RECORD_LAYOUT
/begin RECORD_LAYOUT A_I16 AXIS_PTS_X 1 SWORD INDEX_INCR DIRECT /end RECORD_LAYOUT
/begin RECORD_LAYOUT A_I32 AXIS_PTS_X 1 SLONG INDEX_INCR DIRECT /end RECORD_LAYOUT
/begin RECORD_LAYOUT A_I64 AXIS_PTS_X 1 A_INT64 INDEX_INCR DIRECT /end RECORD_LAYOUT
/begin RECORD_LAYOUT A_F32 AXIS_PTS_X 1 FLOAT32_IEEE INDEX_INCR DIRECT /end RECORD_LAYOUT
/begin RECORD_LAYOUT A_F64 AXIS_PTS_X 1 FLOAT64_IEEE INDEX_INCR DIRECT /end RECORD_LAYOUT
/* Predefined measurement and characteristic typedefs for standard types */
/begin TYPEDEF_MEASUREMENT M_BOOL "" UBYTE BOOL 0 0 0 1 /end TYPEDEF_MEASUREMENT
/begin TYPEDEF_MEASUREMENT M_U8 "" UBYTE NO_COMPU_METHOD 0 0 0 255 /end TYPEDEF_MEASUREMENT
/begin TYPEDEF_MEASUREMENT M_U16 "" UWORD NO_COMPU_METHOD 0 0 0 65535 /end TYPEDEF_MEASUREMENT
/begin TYPEDEF_MEASUREMENT M_U32 "" ULONG NO_COMPU_METHOD 0 0 0 4294967295 /end TYPEDEF_MEASUREMENT
/begin TYPEDEF_MEASUREMENT M_U64 "" A_UINT64 NO_COMPU_METHOD 0 0 0 1e12 /end TYPEDEF_MEASUREMENT
/begin TYPEDEF_MEASUREMENT M_I8 "" SBYTE NO_COMPU_METHOD 0 0 -128 127 /end TYPEDEF_MEASUREMENT
/begin TYPEDEF_MEASUREMENT M_I16 "" SWORD NO_COMPU_METHOD 0 0 -32768 32767 /end TYPEDEF_MEASUREMENT
/begin TYPEDEF_MEASUREMENT M_I32 "" SLONG NO_COMPU_METHOD 0 0 -2147483648 2147483647 /end TYPEDEF_MEASUREMENT
/begin TYPEDEF_MEASUREMENT M_I64 "" A_INT64 NO_COMPU_METHOD 0 0 -1e12 1e12 /end TYPEDEF_MEASUREMENT
/begin TYPEDEF_MEASUREMENT M_F32 "" FLOAT32_IEEE NO_COMPU_METHOD 0 0 -1e12 1e12 /end TYPEDEF_MEASUREMENT
/begin TYPEDEF_MEASUREMENT M_F64 "" FLOAT64_IEEE NO_COMPU_METHOD 0 0 -1e12 1e12 /end TYPEDEF_MEASUREMENT
/begin TYPEDEF_CHARACTERISTIC C_BOOL "" VALUE U8 0 BOOL 0 1 /end TYPEDEF_CHARACTERISTIC
/begin TYPEDEF_CHARACTERISTIC C_U8 "" VALUE U8 0 NO_COMPU_METHOD 0 255 /end TYPEDEF_CHARACTERISTIC
/begin TYPEDEF_CHARACTERISTIC C_U16 "" VALUE U16 0 NO_COMPU_METHOD 0 65535 /end TYPEDEF_CHARACTERISTIC
/begin TYPEDEF_CHARACTERISTIC C_U32 "" VALUE U32 0 NO_COMPU_METHOD 0 4294967295 /end TYPEDEF_CHARACTERISTIC
/begin TYPEDEF_CHARACTERISTIC C_U64 "" VALUE U64 0 NO_COMPU_METHOD 0 1e12 /end TYPEDEF_CHARACTERISTIC
/begin TYPEDEF_CHARACTERISTIC C_I8 "" VALUE I8 0 NO_COMPU_METHOD -128 127 /end TYPEDEF_CHARACTERISTIC
/begin TYPEDEF_CHARACTERISTIC C_I16 "" VALUE I16 0 NO_COMPU_METHOD -32768 32767 /end TYPEDEF_CHARACTERISTIC
/begin TYPEDEF_CHARACTERISTIC C_I32 "" VALUE I32 0 NO_COMPU_METHOD -2147483648 2147483647 /end TYPEDEF_CHARACTERISTIC
/begin TYPEDEF_CHARACTERISTIC C_I64 "" VALUE I64 0 NO_COMPU_METHOD -1e12 1e12 /end TYPEDEF_CHARACTERISTIC
/begin TYPEDEF_CHARACTERISTIC C_F64 "" VALUE F64 0 NO_COMPU_METHOD -1e12 1e12 /end TYPEDEF_CHARACTERISTIC
/begin TYPEDEF_CHARACTERISTIC C_F32 "" VALUE F32 0 NO_COMPU_METHOD -1e12 1e12 /end TYPEDEF_CHARACTERISTIC
/begin MOD_PAR "" /end MOD_PAR
/begin IF_DATA XCP
 /begin PROTOCOL_LAYER 0x0104 1000 2000 0 0 0 0 0 248 1024 BYTE_ORDER_MSB_LAST ADDRESS_GRANULARITY_BYTE OPTIONAL_CMD GET_COMM_MODE_INFO OPTIONAL_CMD GET_ID OPTIONAL_CMD SET_REQUEST OPTIONAL_CMD SET_MTA OPTIONAL_CMD UPLOAD OPTIONAL_CMD SHORT_UPLOAD OPTIONAL_CMD DOWNLOAD OPTIONAL_CMD SHORT_DOWNLOAD OPTIONAL_CMD GET_CAL_PAGE OPTIONAL_CMD SET_CAL_PAGE OPTIONAL_CMD COPY_CAL_PAGE OPTIONAL_CMD BUILD_CHECKSUM OPTIONAL_CMD GET_DAQ_RESOLUTION_INFO OPTIONAL_CMD GET_DAQ_PROCESSOR_INFO OPTIONAL_CMD FREE_DAQ OPTIONAL_CMD ALLOC_DAQ OPTIONAL_CMD ALLOC_ODT OPTIONAL_CMD ALLOC_ODT_ENTRY OPTIONAL_CMD SET_DAQ_PTR OPTIONAL_CMD WRITE_DAQ OPTIONAL_CMD GET_DAQ_LIST_MODE OPTIONAL_CMD SET_DAQ_LIST_MODE OPTIONAL_CMD START_STOP_SYNCH OPTIONAL_CMD START_STOP_DAQ_LIST OPTIONAL_CMD GET_DAQ_CLOCK OPTIONAL_CMD WRITE_DAQ_MULTIPLE OPTIONAL_CMD TIME_CORRELATION_PROPERTIES OPTIONAL_CMD USER_CMD OPTIONAL_LEVEL1_CMD GET_VERSION /end PROTOCOL_LAYER
 /begin DAQ DYNAMIC 0 3 0 OPTIMISATION_TYPE_DEFAULT ADDRESS_EXTENSION_FREE IDENTIFICATION_FIELD_TYPE_RELATIVE_BYTE GRANULARITY_ODT_ENTRY_SIZE_DAQ_BYTE 0xF8 OVERLOAD_INDICATION_PID /begin TIMESTAMP_SUPPORTED 0x1 SIZE_DWORD UNIT_1US TIMESTAMP_FIXED /end TIMESTAMP_SUPPORTED /* compilation unit = 0, function = foo_on_enter, CFA = 0 */ /begin EVENT "foo_enter" "oo_enter" 0 DAQ 0xFF 0 0 0 CONSISTENCY DAQ /end EVENT /* compilation unit = 0, function = foo_on_leave, CFA = 0 */ /begin EVENT "foo_leave" "oo_leave" 1 DAQ 0xFF 0 0 0 CONSISTENCY DAQ /end EVENT /* compilation unit = 0, function = main, CFA = 0 */ /begin EVENT "mainloop" "mainloop" 2 DAQ 0xFF 0 0 0 CONSISTENCY DAQ /end EVENT /end DAQ
 /begin XCP_ON_UDP_IP 0x0104 5555 ADDRESS "192.168.8.135" /end XCP_ON_UDP_IP
/end IF_DATA
/* TypeDefs */
/begin TYPEDEF_MEASUREMENT delay_us "" ULONG IDENTITY 0 0 0 4294967295 /end TYPEDEF_MEASUREMENT
/begin TYPEDEF_MEASUREMENT foo_iterations "" ULONG IDENTITY 0 0 0 4294967295 /end TYPEDEF_MEASUREMENT
/begin TYPEDEF_MEASUREMENT foo_enabled "" UBYTE IDENTITY 0 0 0 255 /end TYPEDEF_MEASUREMENT
/begin TYPEDEF_STRUCTURE params_t "" 12 /begin STRUCTURE_COMPONENT delay_us delay_us 0 /end STRUCTURE_COMPONENT /begin STRUCTURE_COMPONENT foo_iterations foo_iterations 4 /end STRUCTURE_COMPONENT /begin STRUCTURE_COMPONENT foo_enabled foo_enabled 8 /end STRUCTURE_COMPONENT /end TYPEDEF_STRUCTURE
/begin TYPEDEF_MEASUREMENT arg_a "" SLONG IDENTITY 0 0 -2147483648 2147483647 /end TYPEDEF_MEASUREMENT
/begin TYPEDEF_MEASUREMENT arg_iterations "" ULONG IDENTITY 0 0 0 4294967295 /end TYPEDEF_MEASUREMENT
/begin TYPEDEF_MEASUREMENT ret "" SLONG IDENTITY 0 0 -2147483648 2147483647 /end TYPEDEF_MEASUREMENT
/begin TYPEDEF_MEASUREMENT call_count "" ULONG IDENTITY 0 0 0 4294967295 /end TYPEDEF_MEASUREMENT
/begin TYPEDEF_MEASUREMENT duration_ns "" ULONG IDENTITY 0 0 0 4294967295 /end TYPEDEF_MEASUREMENT
/begin TYPEDEF_MEASUREMENT thread_id "" ULONG IDENTITY 0 0 0 4294967295 /end TYPEDEF_MEASUREMENT
/begin TYPEDEF_MEASUREMENT depth "" ULONG IDENTITY 0 0 0 4294967295 /end TYPEDEF_MEASUREMENT
/begin TYPEDEF_MEASUREMENT return_address "" A_UINT64 IDENTITY 0 0 0 18446744073709552000 /end TYPEDEF_MEASUREMENT
/begin TYPEDEF_MEASUREMENT function "" A_UINT64 IDENTITY 0 0 0 18446744073709552000 /end TYPEDEF_MEASUREMENT
/begin TYPEDEF_STRUCTURE foo_ctx_t "" 48 /begin STRUCTURE_COMPONENT arg_a arg_a 0 /end STRUCTURE_COMPONENT /begin STRUCTURE_COMPONENT arg_iterations arg_iterations 4 /end STRUCTURE_COMPONENT /begin STRUCTURE_COMPONENT ret ret 8 /end STRUCTURE_COMPONENT /begin STRUCTURE_COMPONENT call_count call_count 12 /end STRUCTURE_COMPONENT /begin STRUCTURE_COMPONENT duration_ns duration_ns 16 /end STRUCTURE_COMPONENT /begin STRUCTURE_COMPONENT thread_id thread_id 20 /end STRUCTURE_COMPONENT /begin STRUCTURE_COMPONENT depth depth 24 /end STRUCTURE_COMPONENT /begin STRUCTURE_COMPONENT return_address return_address 32 /end STRUCTURE_COMPONENT /begin STRUCTURE_COMPONENT function function 40 /end STRUCTURE_COMPONENT /end TYPEDEF_STRUCTURE
/begin TYPEDEF_MEASUREMENT pc "" A_UINT64 IDENTITY 0 0 0 18446744073709552000 /end TYPEDEF_MEASUREMENT
/begin TYPEDEF_MEASUREMENT sp "" A_UINT64 IDENTITY 0 0 0 18446744073709552000 /end TYPEDEF_MEASUREMENT
/begin TYPEDEF_MEASUREMENT nzcv "" A_UINT64 IDENTITY 0 0 0 18446744073709552000 /end TYPEDEF_MEASUREMENT
/begin TYPEDEF_MEASUREMENT x "" A_UINT64 IDENTITY 0 0 0 18446744073709552000 MATRIX_DIM 29 /end TYPEDEF_MEASUREMENT
/begin TYPEDEF_MEASUREMENT fp "" A_UINT64 IDENTITY 0 0 0 18446744073709552000 /end TYPEDEF_MEASUREMENT
/begin TYPEDEF_MEASUREMENT lr "" A_UINT64 IDENTITY 0 0 0 18446744073709552000 /end TYPEDEF_MEASUREMENT
/begin TYPEDEF_MEASUREMENT v "" UBYTE IDENTITY 0 0 0 255 MATRIX_DIM 32 /end TYPEDEF_MEASUREMENT
/begin TYPEDEF_STRUCTURE GumCpuContext "" 784 /begin STRUCTURE_COMPONENT pc pc 0 /end STRUCTURE_COMPONENT /begin STRUCTURE_COMPONENT sp sp 8 /end STRUCTURE_COMPONENT /begin STRUCTURE_COMPONENT nzcv nzcv 16 /end STRUCTURE_COMPONENT /begin STRUCTURE_COMPONENT x x 24 /end STRUCTURE_COMPONENT /begin STRUCTURE_COMPONENT fp fp 256 /end STRUCTURE_COMPONENT /begin STRUCTURE_COMPONENT lr lr 264 /end STRUCTURE_COMPONENT /begin STRUCTURE_COMPONENT v v 272 /end STRUCTURE_COMPONENT /end TYPEDEF_STRUCTURE
/begin TYPEDEF_MEASUREMENT prepare "" A_UINT64 IDENTITY 0 0 0 18446744073709552000 /end TYPEDEF_MEASUREMENT
/begin TYPEDEF_MEASUREMENT check "" A_UINT64 IDENTITY 0 0 0 18446744073709552000 /end TYPEDEF_MEASUREMENT
/begin TYPEDEF_MEASUREMENT dispatch "" A_UINT64 IDENTITY 0 0 0 18446744073709552000 /end TYPEDEF_MEASUREMENT
/begin TYPEDEF_MEASUREMENT finalize "" A_UINT64 IDENTITY 0 0 0 18446744073709552000 /end TYPEDEF_MEASUREMENT
/begin TYPEDEF_MEASUREMENT closure_callback "" A_UINT64 IDENTITY 0 0 0 18446744073709552000 /end TYPEDEF_MEASUREMENT
/begin TYPEDEF_MEASUREMENT closure_marshal "" A_UINT64 IDENTITY 0 0 0 18446744073709552000 /end TYPEDEF_MEASUREMENT
/begin TYPEDEF_STRUCTURE GSourceFuncs "" 48 /begin STRUCTURE_COMPONENT prepare prepare 0 /end STRUCTURE_COMPONENT /begin STRUCTURE_COMPONENT check check 8 /end STRUCTURE_COMPONENT /begin STRUCTURE_COMPONENT dispatch dispatch 16 /end STRUCTURE_COMPONENT /begin STRUCTURE_COMPONENT finalize finalize 24 /end STRUCTURE_COMPONENT /begin STRUCTURE_COMPONENT closure_callback closure_callback 32 /end STRUCTURE_COMPONENT /begin STRUCTURE_COMPONENT closure_marshal closure_marshal 40 /end STRUCTURE_COMPONENT /end TYPEDEF_STRUCTURE
/begin TYPEDEF_MEASUREMENT p "" A_UINT64 IDENTITY 0 0 0 18446744073709552000 /end TYPEDEF_MEASUREMENT
/begin TYPEDEF_MEASUREMENT notify "" A_UINT64 IDENTITY 0 0 0 18446744073709552000 /end TYPEDEF_MEASUREMENT
/begin TYPEDEF_MEASUREMENT flags "" ULONG IDENTITY 0 0 0 4294967295 /end TYPEDEF_MEASUREMENT
/begin TYPEDEF_MEASUREMENT future "" A_UINT64 IDENTITY 0 0 0 18446744073709552000 /end TYPEDEF_MEASUREMENT
/begin TYPEDEF_STRUCTURE GPrivate "" 32 /begin STRUCTURE_COMPONENT p p 0 /end STRUCTURE_COMPONENT /begin STRUCTURE_COMPONENT notify notify 8 /end STRUCTURE_COMPONENT /begin STRUCTURE_COMPONENT flags flags 16 /end STRUCTURE_COMPONENT /begin STRUCTURE_COMPONENT future future 24 /end STRUCTURE_COMPONENT /end TYPEDEF_STRUCTURE
/begin TYPEDEF_MEASUREMENT ref "" A_UINT64 IDENTITY 0 0 0 18446744073709552000 /end TYPEDEF_MEASUREMENT
/begin TYPEDEF_MEASUREMENT unref "" A_UINT64 IDENTITY 0 0 0 18446744073709552000 /end TYPEDEF_MEASUREMENT
/begin TYPEDEF_MEASUREMENT get "" A_UINT64 IDENTITY 0 0 0 18446744073709552000 /end TYPEDEF_MEASUREMENT
/begin TYPEDEF_STRUCTURE GSourceCallbackFuncs "" 24 /begin STRUCTURE_COMPONENT ref ref 0 /end STRUCTURE_COMPONENT /begin STRUCTURE_COMPONENT unref unref 8 /end STRUCTURE_COMPONENT /begin STRUCTURE_COMPONENT get get 16 /end STRUCTURE_COMPONENT /end TYPEDEF_STRUCTURE
/* Measurements */
/* Measurements for event 'foo_enter' */
/begin INSTANCE foo_enter_cpu_context "" GumCpuContext 0x9D21C0 ECU_ADDRESS_EXTENSION 0
 /begin IF_DATA XCP
  /begin DAQ_EVENT VARIABLE /begin DEFAULT_EVENT_LIST EVENT 0 /end DEFAULT_EVENT_LIST /end DAQ_EVENT
 /end IF_DATA
/end INSTANCE
/* Measurements for event 'foo_leave' */
/begin MEASUREMENT foo_on_leave.now "" A_UINT64 IDENTITY 0 0 0 18446744073709552000 ECU_ADDRESS 0x40FFF0 ECU_ADDRESS_EXTENSION 2
 /begin IF_DATA XCP
  /begin DAQ_EVENT VARIABLE /begin DEFAULT_EVENT_LIST EVENT 1 /end DEFAULT_EVENT_LIST /end DAQ_EVENT
 /end IF_DATA
/end MEASUREMENT
/* Measurements for event 'mainloop' */
/begin INSTANCE params "" params_t 0x3905C8 ECU_ADDRESS_EXTENSION 0
 /begin IF_DATA XCP
  /begin DAQ_EVENT VARIABLE /begin DEFAULT_EVENT_LIST EVENT 2 /end DEFAULT_EVENT_LIST /end DAQ_EVENT
 /end IF_DATA
/end INSTANCE
/begin MEASUREMENT params_calseg "" UWORD IDENTITY 0 0 0 65535 ECU_ADDRESS 0x9D07B8
 /begin IF_DATA XCP
  /begin DAQ_EVENT VARIABLE /begin DEFAULT_EVENT_LIST EVENT 2 /end DEFAULT_EVENT_LIST /end DAQ_EVENT
 /end IF_DATA
/end MEASUREMENT
/begin INSTANCE foo_ctx "" foo_ctx_t 0x9D2188 ECU_ADDRESS_EXTENSION 0
 /begin IF_DATA XCP
  /begin DAQ_EVENT VARIABLE /begin DEFAULT_EVENT_LIST EVENT 2 /end DEFAULT_EVENT_LIST /end DAQ_EVENT
 /end IF_DATA
/end INSTANCE
/begin MEASUREMENT running "" UBYTE IDENTITY 0 0 0 255 ECU_ADDRESS 0x9D07BA
 /begin IF_DATA XCP
  /begin DAQ_EVENT VARIABLE /begin DEFAULT_EVENT_LIST EVENT 2 /end DEFAULT_EVENT_LIST /end DAQ_EVENT
 /end IF_DATA
/end MEASUREMENT
/begin MEASUREMENT main.addr "" UBYTE IDENTITY 0 0 0 255 ECU_ADDRESS 0x80FFC8 ECU_ADDRESS_EXTENSION 2 MATRIX_DIM 4
 /begin IF_DATA XCP
  /begin DAQ_EVENT VARIABLE /begin DEFAULT_EVENT_LIST EVENT 2 /end DEFAULT_EVENT_LIST /end DAQ_EVENT
 /end IF_DATA
/end MEASUREMENT
/begin MEASUREMENT main.counter "" ULONG IDENTITY 0 0 0 4294967295 ECU_ADDRESS 0x80FFFC ECU_ADDRESS_EXTENSION 2
 /begin IF_DATA XCP
  /begin DAQ_EVENT VARIABLE /begin DEFAULT_EVENT_LIST EVENT 2 /end DEFAULT_EVENT_LIST /end DAQ_EVENT
 /end IF_DATA
/end MEASUREMENT
/begin MEASUREMENT evt_id_mainloop "" UWORD IDENTITY 0 0 0 65535 ECU_ADDRESS 0x9D07C0
 /begin IF_DATA XCP
  /begin DAQ_EVENT VARIABLE /begin DEFAULT_EVENT_LIST EVENT 2 /end DEFAULT_EVENT_LIST /end DAQ_EVENT
 /end IF_DATA
/end MEASUREMENT
/begin MEASUREMENT main.last_print "" A_UINT64 IDENTITY 0 0 0 18446744073709552000 ECU_ADDRESS 0x80FFF0 ECU_ADDRESS_EXTENSION 2
 /begin IF_DATA XCP
  /begin DAQ_EVENT VARIABLE /begin DEFAULT_EVENT_LIST EVENT 2 /end DEFAULT_EVENT_LIST /end DAQ_EVENT
 /end IF_DATA
/end MEASUREMENT
/begin MEASUREMENT main.delay_us "" ULONG IDENTITY 0 0 0 4294967295 ECU_ADDRESS 0x80FFDC ECU_ADDRESS_EXTENSION 2
 /begin IF_DATA XCP
  /begin DAQ_EVENT VARIABLE /begin DEFAULT_EVENT_LIST EVENT 2 /end DEFAULT_EVENT_LIST /end DAQ_EVENT
 /end IF_DATA
/end MEASUREMENT
/begin MEASUREMENT main.now "" A_UINT64 IDENTITY 0 0 0 18446744073709552000 ECU_ADDRESS 0x80FFD0 ECU_ADDRESS_EXTENSION 2
 /begin IF_DATA XCP
  /begin DAQ_EVENT VARIABLE /begin DEFAULT_EVENT_LIST EVENT 2 /end DEFAULT_EVENT_LIST /end DAQ_EVENT
 /end IF_DATA
/end MEASUREMENT
/begin MEASUREMENT g_main_context_iterate.timeout "" SLONG IDENTITY 0 0 -2147483648 2147483647 ECU_ADDRESS 0x2617F8
 /begin IF_DATA XCP
  /begin DAQ_EVENT VARIABLE /begin DEFAULT_EVENT_LIST EVENT 2 /end DEFAULT_EVENT_LIST /end DAQ_EVENT
 /end IF_DATA
/end MEASUREMENT
/begin MEASUREMENT g_mem_gc_friendly "" SLONG IDENTITY 0 0 -2147483648 2147483647 ECU_ADDRESS 0x9D5E00
 /begin IF_DATA XCP
  /begin DAQ_EVENT VARIABLE /begin DEFAULT_EVENT_LIST EVENT 2 /end DEFAULT_EVENT_LIST /end DAQ_EVENT
 /end IF_DATA
/end MEASUREMENT
/begin INSTANCE g_timeout_funcs "" GSourceFuncs 0x9D0DC0 ECU_ADDRESS_EXTENSION 0
 /begin IF_DATA XCP
  /begin DAQ_EVENT VARIABLE /begin DEFAULT_EVENT_LIST EVENT 2 /end DEFAULT_EVENT_LIST /end DAQ_EVENT
 /end IF_DATA
/end INSTANCE
/begin INSTANCE g_child_watch_funcs "" GSourceFuncs 0x9D0D48 ECU_ADDRESS_EXTENSION 0
 /begin IF_DATA XCP
  /begin DAQ_EVENT VARIABLE /begin DEFAULT_EVENT_LIST EVENT 2 /end DEFAULT_EVENT_LIST /end DAQ_EVENT
 /end IF_DATA
/end INSTANCE
/begin INSTANCE g_idle_funcs "" GSourceFuncs 0x9D0D78 ECU_ADDRESS_EXTENSION 0
 /begin IF_DATA XCP
  /begin DAQ_EVENT VARIABLE /begin DEFAULT_EVENT_LIST EVENT 2 /end DEFAULT_EVENT_LIST /end DAQ_EVENT
 /end IF_DATA
/end INSTANCE
/begin INSTANCE g_unix_signal_funcs "" GSourceFuncs 0x9D0DF0 ECU_ADDRESS_EXTENSION 0
 /begin IF_DATA XCP
  /begin DAQ_EVENT VARIABLE /begin DEFAULT_EVENT_LIST EVENT 2 /end DEFAULT_EVENT_LIST /end DAQ_EVENT
 /end IF_DATA
/end INSTANCE
/begin INSTANCE g_unix_fd_source_funcs "" GSourceFuncs 0x9D2088 ECU_ADDRESS_EXTENSION 0
 /begin IF_DATA XCP
  /begin DAQ_EVENT VARIABLE /begin DEFAULT_EVENT_LIST EVENT 2 /end DEFAULT_EVENT_LIST /end DAQ_EVENT
 /end IF_DATA
/end INSTANCE
/begin INSTANCE g_io_watch_funcs "" GSourceFuncs 0x9D2018 ECU_ADDRESS_EXTENSION 0
 /begin IF_DATA XCP
  /begin DAQ_EVENT VARIABLE /begin DEFAULT_EVENT_LIST EVENT 2 /end DEFAULT_EVENT_LIST /end DAQ_EVENT
 /end IF_DATA
/end INSTANCE
/begin COMPU_VTAB g_log_always_fatal.table "" TAB_VERB 9 1 "G_LOG_FLAG_RECURSION" 2 "G_LOG_FLAG_FATAL" 4 "G_LOG_LEVEL_ERROR" 8 "G_LOG_LEVEL_CRITICAL" 16 "G_LOG_LEVEL_WARNING" 32 "G_LOG_LEVEL_MESSAGE" 64 "G_LOG_LEVEL_INFO" 128 "G_LOG_LEVEL_DEBUG" -4 "G_LOG_LEVEL_MASK" /end COMPU_VTAB
/begin COMPU_METHOD g_log_always_fatal "" TAB_VERB "%.0" "" COMPU_TAB_REF g_log_always_fatal.table /end COMPU_METHOD
/begin MEASUREMENT g_log_always_fatal "" SLONG g_log_always_fatal 0 0 -2147483648 2147483647 ECU_ADDRESS 0x9D0ED8
 /begin IF_DATA XCP
  /begin DAQ_EVENT VARIABLE /begin DEFAULT_EVENT_LIST EVENT 2 /end DEFAULT_EVENT_LIST /end DAQ_EVENT
 /end IF_DATA
/end MEASUREMENT
/begin COMPU_VTAB g_log_msg_prefix.table "" TAB_VERB 9 1 "G_LOG_FLAG_RECURSION" 2 "G_LOG_FLAG_FATAL" 4 "G_LOG_LEVEL_ERROR" 8 "G_LOG_LEVEL_CRITICAL" 16 "G_LOG_LEVEL_WARNING" 32 "G_LOG_LEVEL_MESSAGE" 64 "G_LOG_LEVEL_INFO" 128 "G_LOG_LEVEL_DEBUG" -4 "G_LOG_LEVEL_MASK" /end COMPU_VTAB
/begin COMPU_METHOD g_log_msg_prefix "" TAB_VERB "%.0" "" COMPU_TAB_REF g_log_msg_prefix.table /end COMPU_METHOD
/begin MEASUREMENT g_log_msg_prefix "" SLONG g_log_msg_prefix 0 0 -2147483648 2147483647 ECU_ADDRESS 0x9D0EDC
 /begin IF_DATA XCP
  /begin DAQ_EVENT VARIABLE /begin DEFAULT_EVENT_LIST EVENT 2 /end DEFAULT_EVENT_LIST /end DAQ_EVENT
 /end IF_DATA
/end MEASUREMENT
/begin MEASUREMENT g_get_worker_context.initialised "" A_UINT64 IDENTITY 0 0 0 18446744073709552000 ECU_ADDRESS 0x9D5AD0
 /begin IF_DATA XCP
  /begin DAQ_EVENT VARIABLE /begin DEFAULT_EVENT_LIST EVENT 2 /end DEFAULT_EVENT_LIST /end DAQ_EVENT
 /end IF_DATA
/end MEASUREMENT
/begin MEASUREMENT g_main_context_new_with_flags.initialised "" A_UINT64 IDENTITY 0 0 0 18446744073709552000 ECU_ADDRESS 0x9D5AC8
 /begin IF_DATA XCP
  /begin DAQ_EVENT VARIABLE /begin DEFAULT_EVENT_LIST EVENT 2 /end DEFAULT_EVENT_LIST /end DAQ_EVENT
 /end IF_DATA
/end MEASUREMENT
/begin MEASUREMENT g_main_context_wait.warned "" SLONG IDENTITY 0 0 -2147483648 2147483647 ECU_ADDRESS 0x9D5A7C
 /begin IF_DATA XCP
  /begin DAQ_EVENT VARIABLE /begin DEFAULT_EVENT_LIST EVENT 2 /end DEFAULT_EVENT_LIST /end DAQ_EVENT
 /end IF_DATA
/end MEASUREMENT
/begin MEASUREMENT glib_worker_running "" SLONG IDENTITY 0 0 -2147483648 2147483647 ECU_ADDRESS 0x9D5AB0
 /begin IF_DATA XCP
  /begin DAQ_EVENT VARIABLE /begin DEFAULT_EVENT_LIST EVENT 2 /end DEFAULT_EVENT_LIST /end DAQ_EVENT
 /end IF_DATA
/end MEASUREMENT
/begin MEASUREMENT unix_signal_pending "" SLONG IDENTITY 0 0 -2147483648 2147483647 ECU_ADDRESS 0x9D5AE8 MATRIX_DIM 65
 /begin IF_DATA XCP
  /begin DAQ_EVENT VARIABLE /begin DEFAULT_EVENT_LIST EVENT 2 /end DEFAULT_EVENT_LIST /end DAQ_EVENT
 /end IF_DATA
/end MEASUREMENT
/begin MEASUREMENT any_unix_signal_pending "" SLONG IDENTITY 0 0 -2147483648 2147483647 ECU_ADDRESS 0x9D5A88
 /begin IF_DATA XCP
  /begin DAQ_EVENT VARIABLE /begin DEFAULT_EVENT_LIST EVENT 2 /end DEFAULT_EVENT_LIST /end DAQ_EVENT
 /end IF_DATA
/end MEASUREMENT
/begin MEASUREMENT unix_signal_refcount "" ULONG IDENTITY 0 0 0 4294967295 ECU_ADDRESS 0x9D5BF0 MATRIX_DIM 65
 /begin IF_DATA XCP
  /begin DAQ_EVENT VARIABLE /begin DEFAULT_EVENT_LIST EVENT 2 /end DEFAULT_EVENT_LIST /end DAQ_EVENT
 /end IF_DATA
/end MEASUREMENT
/begin MEASUREMENT glib_worker_was_running "" SLONG IDENTITY 0 0 -2147483648 2147483647 ECU_ADDRESS 0x9D5AC0
 /begin IF_DATA XCP
  /begin DAQ_EVENT VARIABLE /begin DEFAULT_EVENT_LIST EVENT 2 /end DEFAULT_EVENT_LIST /end DAQ_EVENT
 /end IF_DATA
/end MEASUREMENT
/begin INSTANCE thread_context_stack "" GPrivate 0x9D0E20 ECU_ADDRESS_EXTENSION 0
 /begin IF_DATA XCP
  /begin DAQ_EVENT VARIABLE /begin DEFAULT_EVENT_LIST EVENT 2 /end DEFAULT_EVENT_LIST /end DAQ_EVENT
 /end IF_DATA
/end INSTANCE
/begin INSTANCE g_source_callback_funcs "" GSourceCallbackFuncs 0x9D0DA8 ECU_ADDRESS_EXTENSION 0
 /begin IF_DATA XCP
  /begin DAQ_EVENT VARIABLE /begin DEFAULT_EVENT_LIST EVENT 2 /end DEFAULT_EVENT_LIST /end DAQ_EVENT
 /end IF_DATA
/end INSTANCE
/begin MEASUREMENT timer_perturb "" SLONG IDENTITY 0 0 -2147483648 2147483647 ECU_ADDRESS 0x9D0E40
 /begin IF_DATA XCP
  /begin DAQ_EVENT VARIABLE /begin DEFAULT_EVENT_LIST EVENT 2 /end DEFAULT_EVENT_LIST /end DAQ_EVENT
 /end IF_DATA
/end MEASUREMENT
/begin INSTANCE depth_private "" GPrivate 0x9D0D28 ECU_ADDRESS_EXTENSION 0
 /begin IF_DATA XCP
  /begin DAQ_EVENT VARIABLE /begin DEFAULT_EVENT_LIST EVENT 2 /end DEFAULT_EVENT_LIST /end DAQ_EVENT
 /end IF_DATA
/end INSTANCE
/* Measurements without fixed event */
/begin GROUP Measurements "" ROOT /begin SUB_GROUP foo_enter foo_leave mainloop /end SUB_GROUP /end GROUP
/begin GROUP foo_enter "" /begin REF_MEASUREMENT foo_enter_cpu_context /end REF_MEASUREMENT /end GROUP
/begin GROUP foo_leave "" /begin REF_MEASUREMENT foo_on_leave.now /end REF_MEASUREMENT /end GROUP
/begin GROUP mainloop ""
 /begin REF_MEASUREMENT params params_calseg foo_ctx running main.addr main.counter evt_id_mainloop main.last_print main.delay_us main.now g_main_context_iterate.timeout g_mem_gc_friendly g_timeout_funcs g_child_watch_funcs g_idle_funcs g_unix_signal_funcs g_unix_fd_source_funcs g_io_watch_funcs g_log_always_fatal g_log_msg_prefix g_get_worker_context.initialised g_main_context_new_with_flags.initialised g_main_context_wait.warned glib_worker_running unix_signal_pending any_unix_signal_pending unix_signal_refcount glib_worker_was_running thread_context_stack g_source_callback_funcs timer_perturb depth_private /end REF_MEASUREMENT
/end GROUP
/* Axis */
/* Characteristics */
/* Characteristic and Axis Groups */
/end MODULE
/end PROJECT
